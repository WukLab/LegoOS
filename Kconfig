## drivers/eth/Kconfig
```kconfig
menu "Ethernet"

menuconfig E1000
	tristate "e1000 driver"
	---help---
	  Driver for Intel E1000.

menuconfig TG3
	tristate "tg3 driver"
	---help---
	  Driver for Broadcom tg3.

endmenu
```

## drivers/infiniband/Kconfig
```kconfig
menu "InfiniBand"

menuconfig INFINIBAND
	tristate "InfiniBand support"
#	depends on PCI || BROKEN
#	depends on HAS_IOMEM
#	depends on NET
#	depends on INET
#	depends on m || IPV6 != m
	select IRQ_POLL
	---help---
	  Core support for InfiniBand (IB).  Make sure to also select
	  any protocols you wish to use as well as drivers for your
	  InfiniBand hardware.

config DEBUG_INFINIBAND_MAD
	bool "Debug MAD"
	default n
	depends on INFINIBAND
	depends on DEBUG_KERNEL
	help
	  Enable if you want to print a message whenever this host
	  receive IB management datagram (MAD) from subnet manager.

	  If unsure say N.

config DEBUG_INFINIBAND_QP_TABLE
	bool "Debug QP table operations"
	default n
	depends on INFINIBAND
	depends on DEBUG_KERNEL
	help
	 Enable if you want to track per IB device QP table activities.
	 This is Lego mlx4en specific.

	 If unsure, say N.

config DEBUG_INFINIBAND_CQ_TABLE
	bool "Debug CQ table operations"
	default n
	depends on INFINIBAND
	depends on DEBUG_KERNEL
	help
	 Enable if you want to track per IB device CQ table activities.
	 This is Lego mlx4en specific.

	 If unsure, say N.

if INFINIBAND

source "drivers/infiniband/hw/mlx4/Kconfig"
source "drivers/infiniband/ulp/ipoib/Kconfig"

endif # INFINIBAND

endmenu
```

## drivers/infiniband/hw/mlx4en/Kconfig
```kconfig
#
# Mellanox driver configuration
#

config MLX4_CORE
	tristate
	depends on PCI
	default n

config MLX4_DEBUG
	bool "Verbose debugging output" if (MLX4_CORE && EXPERT)
	depends on MLX4_CORE
	default y
	---help---
	  This option causes debugging code to be compiled into the
	  mlx4_core driver.  The output can be turned on via the
	  debug_level module parameter (which can also be set after
	  the driver is loaded through sysfs).
```

## drivers/tty/Kconfig
```kconfig
menu "TTY Layer Configurations"

config TTY_VT
	bool "Virtual Terminal Output"
	default n
	help
	  If you say Y here, the printk() function will emit the formatted
	  string to Virtual Terminal (VT) layer. It may slightly slow the
	  printk() function call. If you are running this in a monitor-less
	  machine, say N.

	  Currently, the VT layer only supports VGA device.

config TTY_SERIAL
	bool "Serial Output"
	default y
	help
	  If you say Y here, the printk() function will emit the formatted
	  string to Serial layer. If you are debugging Lego via serial port,
	  you must say Y here.

choice
	prompt "TTY Port"
	depends on TTY_SERIAL
	default TTY_SERIAL_TTYS1

config TTY_SERIAL_TTYS0
	bool "ttyS0"

config TTY_SERIAL_TTYS1
	bool "ttyS1"

endchoice

choice
	prompt "TTY Baud Rate"
	depends on TTY_SERIAL
	default TTY_SERIAL_BAUD115200

config TTY_SERIAL_BAUD9600
	bool "Baud 9600"

config TTY_SERIAL_BAUD115200
	bool "Baud 115200"

endchoice

endmenu
```

## fs/Kconfig
```kconfig
#
# File system configuration
#

menu "Executable Formats"

config BINFMT_ELF
	bool "Kernel support for ELF binaries"
	select ELFCORE
	default y
	---help---
	  ELF (Executable and Linkable Format) is a format for libraries and
	  executables used across different architectures and operating
	  systems. Saying Y here will enable your kernel to run ELF binaries
	  and enlarge it by about 13 KB. ELF support under Linux has now all
	  but replaced the traditional Linux a.out formats (QMAGIC and ZMAGIC)
	  because it is portable (this does *not* mean that you will be able
	  to run executables from different architectures or operating systems
	  however) and makes building run-time libraries very easy. Many new
	  executables are distributed solely in ELF format. You definitely
	  want to say Y here.

	  Information about ELF is contained in the ELF HOWTO available from
	  <http://www.tldp.org/docs.html#howto>.

config COMPAT_BINFMT_ELF
	bool
	depends on COMPAT && BINFMT_ELF
	select ELFCORE

config CORE_DUMP_DEFAULT_ELF_HEADERS
	bool "Write ELF core dumps with partial segments"
	default y
	depends on BINFMT_ELF && ELF_CORE
	help
	  ELF core dump files describe each memory mapping of the crashed
	  process, and can contain or omit the memory contents of each one.
	  The contents of an unmodified text mapping are omitted by default.

	  For an unmodified text mapping of an ELF object, including just
	  the first page of the file in a core dump makes it possible to
	  identify the build ID bits in the file, without paying the i/o
	  cost and disk space to dump all the text.  However, versions of
	  GDB before 6.7 are confused by ELF core dump files in this format.

	  The core dump behavior can be controlled per process using
	  the /proc/PID/coredump_filter pseudo-file; this setting is
	  inherited.  See Documentation/filesystems/proc.txt for details.

	  This config option changes the default setting of coredump_filter
	  seen at boot time.  If unsure, say Y.

config BINFMT_SCRIPT
	tristate "Kernel support for scripts starting with #!"
	default y
	help
	  Say Y here if you want to execute interpreted scripts starting with
	  #! followed by the path to an interpreter.

	  You can build this support as a module; however, until that module
	  gets loaded, you cannot run scripts.  Thus, if you want to load this
	  module from an initramfs, the portion of the initramfs before loading
	  this module must consist of compiled binaries only.

	  Most systems will not boot if you say M or N here.  If unsure, say Y.

config HAVE_AOUT
       def_bool n

config BINFMT_AOUT
	tristate "Kernel support for a.out and ECOFF binaries"
	depends on HAVE_AOUT
	---help---
	  A.out (Assembler.OUTput) is a set of formats for libraries and
	  executables used in the earliest versions of UNIX.  Linux used
	  the a.out formats QMAGIC and ZMAGIC until they were replaced
	  with the ELF format.

	  The conversion to ELF started in 1995.  This option is primarily
	  provided for historical interest and for the benefit of those
	  who need to run binaries from that era.

	  Most people should answer N here.  If you think you may have
	  occasional use for this format, enable module support above
	  and answer M here to compile this support as a module called
	  binfmt_aout.

	  If any crucial components of your system (such as /sbin/init
	  or /lib/ld.so) are still in a.out format, you will have to
	  say Y here.

config BINFMT_MISC
	tristate "Kernel support for MISC binaries"
	---help---
	  If you say Y here, it will be possible to plug wrapper-driven binary
	  formats into the kernel. You will like this especially when you use
	  programs that need an interpreter to run like Java, Python, .NET or
	  Emacs-Lisp. It's also useful if you often run DOS executables under
	  the Linux DOS emulator DOSEMU (read the DOSEMU-HOWTO, available from
	  <http://www.tldp.org/docs.html#howto>). Once you have
	  registered such a binary class with the kernel, you can start one of
	  those programs simply by typing in its name at a shell prompt; Linux
	  will automatically feed it to the correct interpreter.

	  You can do other nice things, too. Read the file
	  <file:Documentation/binfmt_misc.txt> to learn how to use this
	  feature, <file:Documentation/admin-guide/java.rst> for information about how
	  to include Java support. and <file:Documentation/admin-guide/mono.rst> for
          information about how to include Mono-based .NET support.

          To use binfmt_misc, you will need to mount it:
		mount binfmt_misc -t binfmt_misc /proc/sys/fs/binfmt_misc

	  You may say M here for module support and later load the module when
	  you have use for it; the module is called binfmt_misc. If you
	  don't know what to answer at this point, say Y.

config COREDUMP
	bool "Enable core dump support" if EXPERT
	default y
	help
	  This option enables support for performing core dumps. You almost
	  certainly want to say Y here. Not necessary on systems that never
	  need debugging or only ever run flawless code.

endmenu
```

## init/Kconfig
```kconfig
menu "Misc Configurations"
config ARCH
	string
	option env="ARCH"

config KERNELVERSION
	string
	option env="KERNELVERSION"

config INIT_ENV_ARG_LIMIT
	int
	default 32
	help
	  Maximum of each of the number of arguments and environment
	  variables passed to init from the kernel command line.

config CROSS_COMPILE
	string "Cross-compiler tool prefix"
	help
	  Same as running 'make CROSS_COMPILE=prefix-' but stored for
	  default make runs in this kernel build directory.  You don't
	  need to set this unless you want the configured kernel build
	  directory to select the cross-compiler automatically.

config LOCALVERSION
	string "Local version - append to kernel release"
	help
	  Append an extra string to the end of your kernel version.
	  This will show up when you type uname, for example.
	  The string you set here will be appended after the contents of
	  any files with a filename matching localversion* in your
	  object and source tree, in that order.  Your total string can
	  be a maximum of 64 characters.

config LOCALVERSION_AUTO
	bool "Automatically append version information to the version string"
	default n
	help
	  This will try to automatically determine if the current tree is a
	  release tree by looking for git tags that belong to the current
	  top of tree revision.

	  A string of the format -gxxxxxxxx will be added to the localversion
	  if a git-based tree is found.  The string generated by this will be
	  appended after any matching localversion* files, and after the value
	  set in CONFIG_LOCALVERSION.

	  (The actual string used here is the first eight characters produced
	  by running the command:

	    $ git rev-parse --verify HEAD

	  which is done within the script "scripts/setlocalversion".)

config CMDLINE_BOOL
	bool "Built-in kernel command line"
	---help---
	  Allow for specifying boot arguments to the kernel at
	  build time.  On some systems (e.g. embedded ones), it is
	  necessary or convenient to provide some or all of the
	  kernel boot arguments with the kernel itself (that is,
	  to not rely on the boot loader to provide them.)

	  To compile command line arguments into the kernel,
	  set this option to 'Y', then fill in the
	  boot arguments in CONFIG_CMDLINE.

	  Systems with fully functional boot loaders (i.e. non-embedded)
	  should leave this option set to 'N'.

config CMDLINE
	string "Built-in kernel command string"
	depends on CMDLINE_BOOL
	default ""
	---help---
	  Enter arguments here that should be compiled into the kernel
	  image and used at boot time.  If the boot loader provides a
	  command line at boot time, it is appended to this string to
	  form the full kernel command line, when the system boots.

	  In most cases, the command line (whether built-in or provided
	  by the boot loader) should specify the device for the root
	  file system.

config FRAME_POINTER
	bool "Compile the kernel with frame pointers"
	default y
	help
	  If you say Y here the resulting kernel image will be slightly
	  larger and slower, but it gives _very_ useful debugging information
	  in case of kernel bugs. (precise oopses/stacktraces/warnings)

	  Enable this if you are hacking the kernel. :)


config KALLSYMS
	 bool "Load all symbols for debugging/ksymoops" if EXPERT
	 default y
	 help
	   Say Y here to let the kernel print out symbolic crash information and
	   symbolic stack backtraces. This increases the size of the kernel
	   somewhat, as all symbols have to be loaded into the kernel image.

config KALLSYMS_ALL
	bool "Include all symbols in kallsyms"
	depends on KALLSYMS
	help
	   Normally kallsyms only contains the symbols of functions for nicer
	   OOPS messages and backtraces (i.e., symbols from the text and inittext
	   sections). This is sufficient for most cases. And only in very rare
	   cases (e.g., when a debugger is used) all symbols are required (e.g.,
	   names of variables from the data sections, etc).

	   This option makes sure that all symbols are loaded into the kernel
	   image (i.e., symbols from all sections) in cost of increased kernel
	   size (depending on the kernel configuration, it may be 300KiB or
	   something like this).

	   Say N unless you really need all symbols.

config KALLSYMS_ABSOLUTE_PERCPU
	bool
	depends on KALLSYMS
	default X86_64 && SMP

config KALLSYMS_BASE_RELATIVE
	bool
	depends on KALLSYMS
	default y
	help
	  Instead of emitting them as absolute values in the native word size,
	  emit the symbol references in the kallsyms table as 32-bit entries,
	  each containing a relative value in the range [base, base + U32_MAX]
	  or, when KALLSYMS_ABSOLUTE_PERCPU is in effect, each containing either
	  an absolute value in the range [0, S32_MAX] or a relative value in the
	  range [base, base + S32_MAX], where base is the lowest relative symbol
	  address encountered in the image.

	  On 64-bit builds, this reduces the size of the address table by 50%,
	  but more importantly, it results in entries whose values are build
	  time constants, and no relocation pass is required at runtime to fix
	  up the entries based on the runtime load address of the kernel.

config DEFAULT_HOSTNAME
	string "Default hostname"
	default "(none)"
	help
	  This option determines the default system hostname before userspace
	  calls sethostname(2). The kernel traditionally uses "(none)" here,
	  but you may wish to use a different default here to make a minimal
	  system more usable with less configuration.

config FUTEX
	bool "FUTEX Support"
	default y
	help
	  Yes, it is futex, something that no one wants to touch but everyone
	  uses every single day. Yes, it is embedded into your glibc.

	  If unsure, just say Y.

config WORK_QUEUE
	bool "Work Queue"
	default n
	help
	  Say Y if want to use workqueue in Lego kernel.
	  Currently we don't have any users, so default to N.

	  If unsure, say N.

menu "Compile-time checks and compiler options"

config DEBUG_INFO
	bool "Compile the kernel with debug info"
	default y
	help
          If you say Y here the resulting kernel image will include
	  debugging info resulting in a larger kernel image.
	  This adds debug symbols to the kernel and modules (gcc -g), and
	  is needed if you intend to use kernel crashdump or binary object
	  tools like crash, kgdb, LKCD, gdb, etc on the kernel.
	  Say Y here only if you plan to debug the kernel.

	  If unsure, say N.
	
config DEBUG_INFO_SPLIT
	bool "Produce split debuginfo in .dwo files"
	depends on DEBUG_INFO
	help
	  Generate debug info into separate .dwo files. This significantly
	  reduces the build directory size for builds with DEBUG_INFO,
	  because it stores the information only once on disk in .dwo
	  files instead of multiple times in object files and executables.
	  In addition the debug information is also compressed.

	  Requires recent gcc (4.7+) and recent gdb/binutils.
	  Any tool that packages or reads debug information would need
	  to know about the .dwo files and include them.
	  Incompatible with older versions of ccache.

endmenu

menu "Basic Kernel Debug and Trace Options"
config DEBUG_KERNEL
	bool "Kernel debugging"
	default n
	help
	  Say Y here if you are developing or trying to debug and
	  identify kernel problems.

config DEBUG_EXIT
	bool "Debug all thread exit activities"
	default n
	depends on DEBUG_KERNEL
	help
	  Enable if you want to know what threads have exited during runtime.
	  This is useful when you are debugging multi-thread applications or
	  building threads/processes related syscalls, e.g. wait(), kill().

	  If unsure, say N.

config DEBUG_SIGNAL
	bool "Debug signal"
	default n
	depends on DEBUG_KERNEL
	help
	  Enable if you want to know what signals have been caught
	  by a running thread.

	  If unsure, say N.

source "kernel/locking/Kconfig"
endmenu # Basic Kernel Debug and Trace Options

endmenu
```
