## managers/processor/Kconfig
```kconfig
menu "Lego Processor Component Configurations"

config COMP_PROCESSOR
	bool "Configure Lego as processor component"
	default n
	select PROCESSOR_ENABLE_SPLIT_PMD_PTLOCK
	select PROCESSOR_MEMMAP_MEMBLOCK_RESERVED
	---help---
	  Say Y if you are going to build a processor-component
	  controller of Lego OS.

if COMP_PROCESSOR

config CHECKPOINT
	bool "Enable Process Checkpoint"
	default n
	---help---
	  Say Y if you want periodic checkpointing at processor component.
	  This may slow down application throughput, but could greatly improve
	  the reliability of your system.

	  If unsure, say N.

#
# Heavily threaded applications may benefit from splitting the mm-wide
# page_table_lock, so that faults on different parts of the user address
# space can be handled with less contention: split it at this NR_CPUS.
# Default to 4 for wider testing, though 8 might be more appropriate.
# DEBUG_SPINLOCK and DEBUG_LOCK_ALLOC spinlock_t also enlarge struct page.
#
config PROCESSOR_SPLIT_PTLOCK_CPUS
	int
	default "4"

#
# Use per-pmd ptlock
# This should only be selected by Processor Manager
#
config PROCESSOR_ENABLE_SPLIT_PMD_PTLOCK
	bool

config PROCESSOR_MEMMAP_MEMBLOCK_RESERVED
	bool "Reseve memmap $ marked memory to memblock"
	default y
	help
	  By default, memmap $ option reserves a range of physical memory.
	  This reserved memory will be marked reserved in e820 table, which
	  means this range will not be registered into memblock.

	  Only memory that has been registered into memblock will be assigned
	  `struct page' with it (both memblock.memory and memblock.reserver will have).
	  Do note that this part of memory can be mapped as 1GB page (depends on boot time).

	  In other words, by default (the linux semantic), users need to ioremap
	  the memmap $ reserved physical memory, and use the returned kernel virtual address.
	  Do note that the ioremap() currently in Lego only support 4KB mapping.

	  If this option is enabled, the memory marked by memmap $ will NOT be marked
	  reserved in e820 table, instead, it will be pushed into memblock, which means
	  it is mapped into kernel direct mapping and has `struct page'.

	  So, why we are having this?
	  Because I think the direct 1GB mapping may have better performance.
	  However, the real performance number is unknown.

	  If unsure, say y.

menu "Processor Side Replication Configuration"
config REPLICATION_MEMORY
	bool "Enable Replicating Memory"
	default n
	help
	  If this option is enabled, every victim cache flush will also be
	  sent over to a Replica Memory Node, or Secondary Memory Node.

	  This option is independent of M side REPLICATION_VMA.

	  If you want to be able to recover from memory component failure,
	  you should have both enabled at P and M.

	  If unsure, say N.
endmenu

source "managers/processor/pcache/Kconfig"
source "managers/processor/fs/Kconfig"
source "managers/processor/checkpoint/Kconfig"

menu "Processor Side Syscall Trace Options"
config STRACE
	bool "syscall trace"
	default n
	depends on DEBUG_KERNEL
	depends on COMP_PROCESSOR
	help
	  This enables kernel version syscall tracer.
	  Each thread has its own set of counters to record number of
	  syscalls happened during process lifetime.

	  NOTE!!! The stat printed are accumulated from all threads
	  within a group.

config STRACE_PRINT_ON_ENTER
	bool "print strace on syscall enter"
	default n
	depends on STRACE

config STRACE_PRINT_ON_LEAVE
	bool "print strace on syscall leave"
	default n
	depends on STRACE

config STRACE_PRINT_ON_SPECIFIC
	bool "print only specfic syscalls"
	default n
	depends on STRACE
endmenu

menu "Processor Side Global Monitor Configuration"
config GPM
	bool "Global processor monitor"
	default n
	help
	  Enable this if you have a Global Processor Monitor machine
	  running in the cluster.

	  If unsure, say N

if GPM
config GPM_NODEID
	int "GMM IB node ID"
	default 3
	help
	  if running a multiple monitor on same machine, IB node
	  ID can be same as Storage node, GMM, and GSM's

config VNODE
	bool "Virtual node"
	default n
	help
	  Enable virtual node namespace

config VNODE_TABLE_ORDER
	int "Virtual node hash table order"
	default 10
	depends on VNODE
	help
	  Order of vnode hashable used for transfering IP to vnode_struct
	  The number of hashtable entries will be (1<<ORDER).

	  If unsure, use default.

config VNODE_MAP_ORDER
	int "Virtual node array order"
	default 10
	depends on VNODE
	help
	  Order of vnode array used for transfering vnode id to vnode_struct
	  The number of the array will be (1<<ORDER)

	  If unsure, use default.
endif #if GPM
endmenu

menu "Processor Side DEBUG Options"
config DEBUG_PCACHE
	bool "Debug pcache"
	default n
	depends on COMP_PROCESSOR
	depends on DEBUG_KERNEL
	help
	  This will enable PCACHE_BUG_ON macro etc. Enable this if you
	  are developing pcache subsystem.

	  If unsure, say N.

config DEBUG_PCACHE_FILL
	bool "Debug pcache fill"
	default n
	depends on COMP_PROCESSOR
	depends on DEBUG_KERNEL
	depends on DEBUG_PCACHE
	help
	  Enable to have a detailed dump log of pcache llc miss activities.
	  It basically tells you what lines are fetched from remote. This
	  option may produce *a lot* messages, hence by default it is
	  ratelimited.

	  If unsure, say N

config DEBUG_PCACHE_FILL_UNLIMITED
	bool "Debug pcache fill, print message un-ratelimited"
	default n
	depends on DEBUG_PCACHE_FILL
	help
	  Enable to have un-ratelimited pcache_debug in cache fill path.
	  This indeed will produce a lot messages.

	  If ununsure, say N please.

config DEBUG_PCACHE_FLUSH
	bool "Debug pcache flush"
	default n
	depends on COMP_PROCESSOR
	depends on DEBUG_KERNEL
	depends on DEBUG_PCACHE
	help
	  Enable to have a detailed dump log of pcache flush activities.
	  It basically tells you what lines are flushed, and where they
	  flushed to.

	  If unsure, say N

config DEBUG_PCACHE_VICTIM
	bool "Debug victim cache"
	default n
	depends on COMP_PROCESSOR
	depends on DEBUG_KERNEL
	depends on DEBUG_PCACHE
	depends on PCACHE_EVICTION_VICTIM
	help
	  Enable this option to have some runtime debug info about victim cache.
	  If unsure, say N.

config DEBUG_PCACHE_RMAP
	bool "Debug rmap operations"
	default n
	depends on COMP_PROCESSOR
	depends on DEBUG_KERNEL
	depends on DEBUG_PCACHE
	help
	  Enable this option to trace pcache reverse mapping operations.
	  If unsure say N.

config DEBUG_PCACHE_ZEROFILL
	bool "Debug zerofill"
	default n
	depends on COMP_PROCESSOR
	depends on DEBUG_KERNEL
	depends on PCACHE_ZEROFILL
	help
	  Enable this will tell you what PTEs have been set/cleared,
	  in terms of the Zerofill bit.

	  In unsure, say N.

config DEBUG_FORK
	bool "Debug processor-to-memory fork()"
	default n
	depends on COMP_PROCESSOR
	depends on DEBUG_KERNEL
	help
	  Enable to debug fork syscall.

	  If unsure, say N.

config DEBUG_FILE
	bool "Debug open/read/close calls"
	default n
	depends on COMP_PROCESSOR
	depends on DEBUG_KERNEL
	help
	  Enable to debug file related calls

config DEBUG_SYSCALL
	bool "Debug all SYSCALL enter/exit"
	default n
	depends on COMP_PROCESSOR
	depends on DEBUG_KERNEL
	help
	  Enable to have a detailed dump log of syscall entering and exit.
	  Only used for testing purpose.

	  If unsure, say N.

config DEBUG_MMAP
	bool "Debug mmap() and brk()"
	default n
	depends on COMP_PROCESSOR
	depends on DEBUG_KERNEL
	help
	  Enable to debug mmap(), brk() at processor side.
	  Mostly, it tells you what is returned.

	  If unsure, say N.

config DEBUG_MUNMAP
	bool "Debug munmap()"
	default n
	depends on COMP_PROCESSOR
	depends on DEBUG_KERNEL
	help
	  Enable to debug munmap()

	  If unsure, say N.

config DEBUG_MREMAP
	bool "Debug mremap()"
	default n
	depends on COMP_PROCESSOR
	depends on DEBUG_KERNEL
	help
	  Enable to debug mremap()

	  If unsure, say N.

config DEBUG_PROC_SYS
	bool "Debug /proc and /sys output"
	default n
	depends on COMP_PROCESSOR
	depends on DEBUG_KERNEL
	help
	  Some user-program will open /proc and /sys files to get information
	  about lego-kernel. We are having these two interfaces to maintain
	  compatability with linux.

	  Enable to print the msg everytime /proc and /sys files are read
	  by user program.

	  If unsure, say N.

config DEBUG_EMULATED_PGTABLE
	bool "Debug emulated pgtable operations (may have tons of messages)"
	default n
	depends on COMP_PROCESSOR
	depends on DEBUG_KERNEL
	help
	  Enable to trace the emulated pgtable release function, which is
	  normally invoked by munmap() and mremap(), and combined with
	  DEBUG_MREMAP, and DEBUG_MUNMAP.

	  If unsure, say N.

config DEBUG_CHECKPOINT
	bool "Enable to show checkpoint debug messages"
	default n
	depends on DEBUG_KERNEL
	---help---
	  Say Y if you want to have more info about what is going on about checkpoint.

	  If unsure, say N.

config DEBUG_PIPE
	bool "Debug pipe read/write/open/release"
	default n
	depends on DEBUG_KERNEL
	---help---
	  Say Y if you want to get some hint on what happens internally of a pipe

	  If unsure, say N.

endmenu # "Debug Option"

endif	# if COMP_PROCESSOR

endmenu # Processor component
```

## managers/processor/pcache/Kconfig
```kconfig
#
# Pcache Kconfig Options
#

menu "Processor Side ExCache Configuration"

config PCACHE_ZEROFILL
	bool "pcache zerofill opt"
	default y
	depends on COMP_PROCESSOR
	help
         This option will optimize anonymous cache miss.
         We save extra information in the PTE entry. If a cache line is
         anonymous and is all-zero, we can do the following locally
         - Allocate pcache, clear and return.

         If unsure, say Y.

config PCACHE_ZEROFILL_NOTIFY_MEMORY
	bool "pcache zerofill notify memory"
	default n
	depends on COMP_PROCESSOR
	depends on PCACHE_ZEROFILL
	help
	  In addition to PCACHE_ZEROFILL, enable this option will
	  notify remote memory component about zerofill activities.
	  
	  Note!!! It is not necessary to notify remote memory.
	  Because if the line is evicted, the flush handler will
	  check if the mapping exist or not. If the mapping does
	  not exist, the flush handler will establish one, and do
	  the local copy.

	  Thus we delay the physical memory allocation further than
	  demand paging, it is delayed until pcache flush time.

	  Besides, by doing zerofill on only _anonymous data_ pages,
	  we will not affect code pages, which implies we will not
	  impact the normal code execution flow.

	  In all, avoiding the notification to memory is correct.

	  If unsure, you should say N.

#
# Eviction Algorithm
#
choice
	prompt "Pcache: Eviction Algorithm"
	default PCACHE_EVICT_LRU
	help
	  Allows the selection of pcache eviction algorithm.
	  Eviction happens when pcache allocation made into a full set.

	config PCACHE_EVICT_RANDOM
		bool "Random"
		---help---
		  Enable this option to use random algorithm while doing eviction.

	config PCACHE_EVICT_FIFO
		bool "FIFO"
		---help---
		  Enable this option to use FIFO algorithm while doing eviction.

	config PCACHE_EVICT_LRU
		bool "LRU"
		---help---
		  Enable this option to use LRU algorithm while doing eviction.
		  It also enables PCACHE_EVICT_GENERIC_SWEEP, which will create
		  background sweep threads.
endchoice

config PCACHE_EVICT_GENERIC_SWEEP
	bool "Have a sweep thread to adjust LRU list"
	default n
	depends on PCACHE_EVICT_LRU
	help
	  Certain eviction algorithms (e.g., LRU) require sweep thread to adjust the list.
	  However, sweep is not free. It will 1) occupy a cpu core, 2) content lock with
	  regular running user threads, 3) pollute L1/L2 cpu cache.

	  Thus, personally, I would sugguest you to disable this software-based adjustment.

config PCACHE_EVICT_GENERIC_SWEEP_INTERVAL_MSEC
	int "Pcache: sweep interval in msec"
	depends on PCACHE_EVICT_GENERIC_SWEEP
	range 10 5000
	default 1000
	help
	  The interval between two sweep, in msec.

#
# Eviction Mechanism
#
choice
	prompt "Pcache: Atomic Eviction Mechanism"
	default PCACHE_EVICTION_PERSET_LIST
	help
	 Allows you to select pcache eviction mechasims.
	 This happens after the line to evict is selected by evict algorithm.

	 The eviction will need clflush, and clflush needs atomicity.
	 That is why we need various mechanisms to ensure that the cache line
	 is not changed by application during kernel flush (basically memcpy).

	 Different eviction mechanism will impact pcache fill path.
	 See details below.

	config PCACHE_EVICTION_WRITE_PROTECT
		bool "write-protect evicted line"
		help
		  Once a line is selected to be evicted, we 1) write-protect it,
		  2) flush it back to memory, 3) unmap PTE.

		  This is the most native way of doing atomic clflush. If needs
		  two TLB shootdown to work. If any pgfault happen on the cores,
		  they will wait until flush is finished.

	config PCACHE_EVICTION_PERSET_LIST
		bool "per-set eviction list"
		help
		  Say if want each pcache set to maintain a pending eviction list.
		  Pcache fill path will check this list (or a bitmap) before going
		  to fetch from memory. If pcache fill path find that the faulting
		  address is in the list, it will *wait* until the line is flushed
		  back to memory.

		  This mechanism saves one TLB flush compared with WRPROTECT mechanism.
		  But it introduces one checking in pcache fill path.

	config PCACHE_EVICTION_VICTIM
		bool "victim cache"
		help
		  Say Y if you want a small victim cache between pcache and memory.
		  Victim cache is fully-associated, and it is loaded only when lines
		  are evicted from pcache. In the case of a miss in pcache that hits
		  in the victim cache, the contents can be copied to pcache directly,
		  without any network delay.

		  This mechanism saves one TLB flush compared with WRPROTECT mechanism.
		  It also reduce the waiting of flush in the pcache fill critical path:
		  pcache fill can just grab the content from the victim cache.

		  The downside is it introduces one checking in pcache fill path.
endchoice

config PCACHE_EVICTION_VICTIM_NR_ENTRIES
	int "Pcache: Number of Victim Cache Entries"
	default 8
	range 1 128
	depends on PCACHE_EVICTION_VICTIM
	help
	  This value determines how many entries the victim cache will have.

config PCACHE_PREFETCH
	bool "Pcache: prefetch"
	default y
	help
	  Say Y if you want prefetch feature.

endmenu
```

## memory/Kconfig
```kconfig
menu "Memory Component"

config MEMCOMPONENT
	bool "Memory Component Manager"
	default y

endmenu
```
