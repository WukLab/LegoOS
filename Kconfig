## mm/Kconfig
```kconfig
menu "Memory Management"

config SELECT_MEMORY_MODEL
	def_bool y
	depends on ARCH_SELECT_MEMORY_MODEL

choice
	prompt "Memory model"
	depends on SELECT_MEMORY_MODEL
	default DISCONTIGMEM_MANUAL if ARCH_DISCONTIGMEM_DEFAULT
	default SPARSEMEM_MANUAL if ARCH_SPARSEMEM_DEFAULT
	default FLATMEM_MANUAL


config FLATMEM_MANUAL
	bool "Flat Memory"
	depends on !ARCH_DISCONTIGMEM_ENABLE || ARCH_FLATMEM_ENABLE
	help
	  This option allows you to change some of the ways that
	  LegoOS manages its memory internally.  Most users will
	  only have one option here: FLATMEM.  This is normal
	  and a correct option.

	  Some users of more advanced features like NUMA and
	  memory hotplug may have different options here.
	  DISCONTIGMEM is a more mature, better tested system,
	  but is incompatible with memory hotplug and may suffer
	  decreased performance over SPARSEMEM.

	  If unsure, choose this option (Flat Memory) over any other.

config DISCONTIGMEM_MANUAL
	bool "Discontiguous Memory"
	depends on ARCH_DISCONTIGMEM_ENABLE
	help
	  This option provides enhanced support for discontiguous
	  memory systems, over FLATMEM.  These systems have holes
	  in their physical address spaces, and this option provides
	  more efficient handling of these holes.  However, the vast
	  majority of hardware has quite flat address spaces, and
	  can have degraded performance from the extra overhead that
	  this option imposes.

	  Many NUMA configurations will have this as the only option.

	  If unsure, choose "Flat Memory" over this option.

config SPARSEMEM_MANUAL
	bool "Sparse Memory"
	depends on ARCH_SPARSEMEM_ENABLE
	help
	  This will be the only option for some systems, including
	  memory hotplug systems.  This is normal.

	  For many other systems, this will be an alternative to
	  "Discontiguous Memory".  This option provides some potential
	  performance benefits, along with decreased code complexity,
	  but it is newer, and more experimental.

	  If unsure, choose "Discontiguous Memory" or "Flat Memory"
	  over this option.

endchoice

config DISCONTIGMEM
	def_bool y
	depends on (!SELECT_MEMORY_MODEL && ARCH_DISCONTIGMEM_ENABLE) || DISCONTIGMEM_MANUAL

config SPARSEMEM
	def_bool y
	depends on (!SELECT_MEMORY_MODEL && ARCH_SPARSEMEM_ENABLE) || SPARSEMEM_MANUAL

config FLATMEM
	def_bool y
	depends on (!DISCONTIGMEM && !SPARSEMEM) || FLATMEM_MANUAL

config FLAT_NODE_MEM_MAP
	def_bool y
	depends on !SPARSEMEM

#
# Both the NUMA code and DISCONTIGMEM use arrays of pg_data_t's
# to represent different areas of memory.  This variable allows
# those dependencies to exist individually.
#
config NEED_MULTIPLE_NODES
	def_bool y
	depends on DISCONTIGMEM || NUMA

config HAVE_MEMBLOCK
	bool

config HAVE_MEMBLOCK_NODE_MAP
	bool

#
# SPARSEMEM_EXTREME (which is the default) does some bootmem
# allocations when memory_present() is called.  If this cannot
# be done on your architecture, select this option.  However,
# statically allocating the mem_section[] array can potentially
# consume vast quantities of .bss, so be careful.
#
# This option will also potentially produce smaller runtime code
# with gcc 3.4 and later.
#
config SPARSEMEM_STATIC
	bool

#
# Architecture platforms which require a two level mem_section in SPARSEMEM
# must select this option. This is usually for architecture platforms with
# an extremely sparse physical address space.
#
config SPARSEMEM_EXTREME
	def_bool y
	depends on SPARSEMEM && !SPARSEMEM_STATIC

config SPARSEMEM_VMEMMAP_ENABLE
	bool

config SPARSEMEM_ALLOC_MEM_MAP_TOGETHER
	def_bool y
	depends on SPARSEMEM && X86_64

config SPARSEMEM_VMEMMAP
	bool "Sparse Memory virtual memmap"
	depends on SPARSEMEM && SPARSEMEM_VMEMMAP_ENABLE
	default y
	help
	 SPARSEMEM_VMEMMAP uses a virtually mapped memmap to optimise
	 pfn_to_page and page_to_pfn operations.  This is the most
	 efficient option when sufficient kernel resources are available.

choice
	prompt "Choose kmalloc allocator"
	default SLOB
	help
	   This option allows to select a slab allocator.

config SLAB
	bool "SLAB"
	select HAVE_HARDENED_USERCOPY_ALLOCATOR
	help
	  The regular slab allocator that is established and known to work
	  well in all environments. It organizes cache hot objects in
	  per cpu and per node queues.

config SLUB
	bool "SLUB (Unqueued Allocator)"
	select HAVE_HARDENED_USERCOPY_ALLOCATOR
	help
	   SLUB is a slab allocator that minimizes cache line usage
	   instead of managing queues of cached objects (SLAB approach).
	   Per cpu caching is realized using slabs of objects instead
	   of queues of objects. SLUB can use memory efficiently
	   and has enhanced diagnostics. SLUB is the default choice for
	   a slab allocator.

config SLOB
	bool "SLOB (Simple Allocator)"
	help
	   SLOB replaces the stock allocator with a drastically simpler
	   allocator. SLOB is generally more space efficient but
	   does not perform as well on large systems.

endchoice # "Kmalloc Allocator"

#
# MM Debug Options
#

config DEBUG_MM_ALLOCATION
	bool "Debug kmalloc and buddy allocator"
	depends on DEBUG_KERNEL
	default n

config DEBUG_KMALLOC_USE_BUDDY
	bool "Make kmalloc use buddy directly, kfree is empty"
	depends on DEBUG_KERNEL
	depends on DEBUG_MM_ALLOCATION
	default n
	help
	  Make kmalloc() use buddy allocator directly, without going through
	  slob/slab/slub. This option can be used to catch bugs introduced by kmalloc.

	  If unsure, say N.

config DEBUG_BUDDY_FORCE_GFP_ZERO
	bool "Pass __GFP_ZERO to every physical page allocation (Catch uninitliazed bug)"
	depends on DEBUG_KERNEL
	depends on DEBUG_MM_ALLOCATION
	default n
	help
	  This option is used to catch uninitliazed bug. If this option is on,
	  then all pages allocated by buddy allocator will be cleared upon return.

	  If anything went wrong without this option AND went alright with this option,
	  that means you have uninitialized buffer.

	  If unsure, say N.


endmenu
```

## net/Kconfig
```kconfig
menu "Networking"

config LWIP
	tristate "lwip TCP/IP layer"
	---help---
	  lwip TCP/IP layer.

if INFINIBAND

config FIT
	bool "FIT IB layer"
	default y
	depends on INFINIBAND

config FIT_FIRST_QPN
	int "The first QPN"
	range 80 100
	default 80

config FIT_MAX_RPC_TIMEOUT_SEC
	int "Max send_reply timeout in seconds"
	range 1 300
	default 60
	help
	  Internally, LITE will do polling for outstanding RPC.
	  This is the maximum time in seconds that LITE will give up polling
	  and return.

config FIT_NR_QPS_PER_PAIR
	int "Numer of QPs between each node pair"
	range 4 24
	default 12
	help
	  We have this parameter because of FIT's internal design.
	  For each pair of nodes, FIT will establish this number of QPs.
	  For each message transfer, QP will be selected in a RR fashion.

	  In old NIC, if you have a lot QPs, chances are, you will have QP thrashing.
	  But according to recent study, this is not the case for new NIC, i.e. connectx-4, connectx-5.

	  The default setting 12, just a heuristic number.
	  The upper limit is heuristic.

	  If unsure, use default.

config FIT_NR_RECVCQ_POLLING_THREADS
	int "Number of FIT recv_cq polling threads"
	range 1 4
	default 1
	help
	  We have this parameter because of FIT's internal design.
	  At each node, FIT create this number of recv_cq, and these recv_cq
	  will be shared by all the QPs (configured by FIT_NR_QPS_PER_PAIR).

	  Usuallly, the number of QPs is larger than number of recv_cqs.
	  It means recv_cq is shared by multiple QPs.

	  Each recv_cq has its dedicated polling threads.
	  Thus the more recv_cq you have, the more CPUs are needed for polling.
	  Not a good model, in my opinion.

	  If you have multi-threaded applications running, I suggest you have this
	  number > 1. Otherwise, both throughput and latency will be limited by
	  one single polling thread.

	  If unsure, use default.


config FIT_MAX_OUTSTANDING_SEND
	int "max_send_wr"
	range 1 24
	default 24  if COMP_PROCESSOR
	default 24 if COMP_MEMORY
	depends on FIT
	help
	  This determines the maximum number of concurrent outstanding
	  reply SEND (reply is also a SEND).

	  If unsure, follow default.

config FIT_BATCH_POLL_SEND_CQ
	bool "Poll the send_cq in a batch fashion"
	default n
	depends on FIT
	help
	  Once enabled, FIT layer will not wait for ACK when
	  replying a message to sender, and will return to caller immediately.
	  This means, when the call returns, the reply buffer is not actually
	  sent out. Thus, the reply buffer has to be there for a certain amount of time.
	  But we have the ring buffer, so it is been taken care of.

	  This essentially is just converting poll to batch poll.

	  In our testing, this improves ~600ns for fit_ack_reply_callback().

	  If unsure, say Y.

config FIT_DEBUG
	bool "Enable fit_debug"
	default n
	depends on FIT
	help
	  Enable to enable fit_debug() marco

config FIT_SEQUENTIAL_IBAPI
	bool "Make ibapi sequentially executed"
	default n
	depends on FIT
	depends on DEBUG_KERNEL
	help
	  This option will make ibapi_send_reply() sequentially executed.
	  This is achieved by adding a lock to protec the function.

	  If unsure say N.

config FIT_INITIAL_SLEEP_TIMEOUT
	int "FIT initial sleep timeout (s) for connection"
	default 10
	depends on FIT
	help
	  This is the time you need to wait for FIT to establish
	  connection with other machines. Life is short, make it smaller.

config FIT_NR_NODES
	int "FIT Number of Connected Nodes"
	default 2
	depends on FIT
	help
	  This is the number of nodes that can be connected by FIT layer.
	  Count the nodes you need for testing, and then set the EXACT same
	  value for all the testing nodes.

	  E.g., if you are going to use 4 nodes, then config it as 4.

config FIT_LOCAL_ID
	int "FIT Unique Local ID [0, FIT_NR_NODES)"
	depends on FIT || FIT_NR_NODES
	help
	  This is the local node id, which has to be unique across connected FIT nodes.
	  The raneg of FIT_LOCAL_ID is [0, FIT_NR_NODES - 1).

config SAME_MACHINE_VMS 
	bool "Enable multiple VMs on the same physical machine"
	default n
	depends on FIT

config SOCKET_O_IB
	bool "IB support of Socket"
	default n
	depends on FIT
	help
	  Enable if you want to have socket APIs built over Infiniband.
	  You must enable this on ALL nodes if you want the cluster to support socket.

	  If unsure, say N.

config SOCKET_SYSCALL
	bool "Socket SYSCALL Support"
	default y if COMP_PROCESSOR
	default n if COMP_MEMORY
	depends on SOCKET_O_IB
	help
	  Enable if you need socket SYSCALL on the node. Only processor component
	  can enable this config since that is the only one will run user program.

	  You must enable this if you want to use socket syscall.

	  If unsure, say N.

config SOCKET_SERVER
	bool "socket server test code"
	default n
	depends on SOCKET_SYSCALL
	help
	  Enable to test socket server during boot.

	  If unsure, say N.

config SOCKET_CLIENT
	bool "socket server test code"
	default n
	depends on SOCKET_SYSCALL
	help
	  Enable to test socket client during boot.

	  If unsure, say N.

config DEBUG_SOCKET
	bool "debugging socket system call"
	default n
	depends on SOCKET_SYSCALL
	help
	  Turn on to show socket syscall implementation debugging msgs

config EPOLL
	bool "epoll system call support"
	default n
	depends on SOCKET_SYSCALL
	help
	  Enable to use epoll on socket. Only processor components that have socket
	  support should enable this config. Epoll for other file types are not 
	  supported now.

config DEBUG_EPOLL
	bool "debugging epoll"
	default n
	depends on EPOLL
	help
	  Turn on to show epoll debugging msgs

config DEBUG_POLL
	bool "debugging poll"
	default n
	depends on POLL
	help
	  Turn on to show poll debugging msgs

endif # INFINIBAND

endmenu # Networking
```
